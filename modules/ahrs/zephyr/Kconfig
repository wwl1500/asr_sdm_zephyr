## modules/ahrs/zephyr/Kconfig
```kconfig
# SPDX-License-Identifier: Apache-2.0

config ASR_AHRS
	bool "ASR AHRS fusion"
	default y
	depends on ASR_IMU
	help
	  AHRS fusion helpers built on top of the Fusion algorithm library.

config ASR_AHRS_THREAD
	bool "AHRS background thread"
	default n
	depends on ASR_AHRS
	help
	  Spawns a background thread that periodically reads cached IMU values and
	  updates AHRS outputs.

config ASR_AHRS_STARTUP_DELAY_MS
	int "AHRS thread startup delay in milliseconds"
	default 600
	depends on ASR_AHRS_THREAD
	help
	  Delay before starting periodic AHRS updates.

config ASR_AHRS_PERIOD_MS
	int "AHRS update period in milliseconds"
	default 1000
	depends on ASR_AHRS
	help
	  Delay between AHRS update iterations.
```

## modules/comm/zephyr/Kconfig
```kconfig
# SPDX-License-Identifier: Apache-2.0

config ASR_COMM
	bool "ASR UART communication module"
	default n
	depends on SERIAL && UART_INTERRUPT_DRIVEN
	help
	  UART0-based communication module implementing the ASR SDM protocol.
	  Receives and sends 8-byte protocol messages with frame synchronization
	  over a simple [0xAA 0x55 LEN DATA... CHECKSUM] framing layer.

config ASR_COMM_THREAD_STACK_SIZE
	int "Communication thread stack size"
	default 1024
	depends on ASR_COMM
	help
	  Stack size for the UART communication processing thread.

config ASR_COMM_THREAD_PRIORITY
	int "Communication thread priority"
	default 5
	depends on ASR_COMM
	help
	  Cooperative priority of the UART communication thread.  Lower numbers
	  mean higher priority.

config ASR_COMM_RX_QUEUE_DEPTH
	int "RX message queue depth"
	default 8
	depends on ASR_COMM
	help
	  Maximum number of received frames that can be queued between the ISR
	  and the processing thread before the oldest frame is silently dropped.
```

## modules/common/zephyr/Kconfig
```kconfig
# SPDX-License-Identifier: Apache-2.0

config ASR_COMMON
	bool "ASR common types and utilities"
	default y
	help
	  Shared headers (robot_base.h, sin_table.h) used across ASR modules.
```

## modules/imu/zephyr/Kconfig
```kconfig
# SPDX-License-Identifier: Apache-2.0

config ASR_IMU
	bool "ASR IMU driver"
	default y
	depends on SENSOR
	help
	  Driver helpers for the project's ICM-42688 sensor. Provides device
	  readiness validation and single-sample reads.

config ASR_IMU_THREAD
	bool "IMU read/print background thread"
	default n
	depends on ASR_IMU && UART_LINE_CTRL
	help
	  Spawns a background IMU logging thread using the project's IMU and USB CDC
	  ACM devicetree nodes. Thread timing is configured with the options below.

config ASR_IMU_STARTUP_DELAY_MS
	int "IMU thread startup delay in milliseconds"
	default 500
	depends on ASR_IMU_THREAD
	help
	  Delay before validating the IMU and USB CDC ACM devices and creating the
	  IMU logging thread.

config ASR_IMU_PERIOD_MS
	int "IMU sampling period in milliseconds"
	default 1000
	depends on ASR_IMU_THREAD
	help
	  Delay between successful IMU fetch/log iterations.

config ASR_IMU_DISCONNECTED_POLL_PERIOD_MS
	int "IMU disconnected poll period in milliseconds"
	default 200
	depends on ASR_IMU_THREAD
	help
	  Delay between USB DTR connection checks while the host serial port is not
	  connected.
```

## modules/interface/zephyr/Kconfig
```kconfig
# SPDX-License-Identifier: Apache-2.0

config ASR_USB_INTERFACE
	bool "ASR USB CDC ACM interface"
	default n
	depends on SERIAL && UART_LINE_CTRL
	help
	  Raw USB CDC ACM data pipe. Provides interrupt-driven RX with a
	  background thread that delivers received buffers to a registered
	  callback, and blocking poll-out TX.

config ASR_USB_INTERFACE_THREAD_STACK_SIZE
	int "USB interface thread stack size"
	default 2048
	depends on ASR_USB_INTERFACE
	help
	  Stack size for the USB interface RX processing thread.

config ASR_USB_INTERFACE_THREAD_PRIORITY
	int "USB interface thread priority"
	default 1
	depends on ASR_USB_INTERFACE
	help
	  Priority of the USB interface RX processing thread.

config ASR_USB_INTERFACE_RX_BUF_SIZE
	int "USB interface RX buffer size"
	default 256
	depends on ASR_USB_INTERFACE
	help
	  Maximum number of bytes per received chunk delivered to the RX
	  callback.
```

## modules/led/zephyr/Kconfig
```kconfig
# SPDX-License-Identifier: Apache-2.0

config ASR_USR_LED
	bool "ASR user LED driver (GPIO / PWM)"
	default y
	depends on GPIO
	help
	  Driver for the onboard user LED (GP25 on XIAO RP2350).
	  Uses PWM brightness via pwm-leds when available, otherwise GPIO via gpio-leds.

config ASR_RGB_LED
	bool "ASR WS2812 RGB LED driver"
	default n
	depends on LED_STRIP
	help
	  Driver for the onboard WS2812 NeoPixel RGB LED on XIAO RP2350 (GP22, PIO0).

config ASR_LED_THREAD
	bool "ASR LED background thread"
	default n
	depends on ASR_USR_LED && ASR_RGB_LED
	help
	  Background thread: user LED steady on, RGB LED blinks blue.
```

## modules/monitor/zephyr/Kconfig
```kconfig
# SPDX-License-Identifier: Apache-2.0

config ASR_CPU_MONITOR
	bool "ASR CPU monitor"
	default n
	depends on THREAD_RUNTIME_STATS
	help
	  Periodically logs per-thread CPU usage statistics.

config ASR_CPU_MONITOR_THREAD_STACK_SIZE
	int "CPU monitor thread stack size"
	default 1024
	depends on ASR_CPU_MONITOR
	help
	  Stack size for the CPU monitor background thread.

config ASR_CPU_MONITOR_THREAD_PRIORITY
	int "CPU monitor thread priority"
	default 10
	depends on ASR_CPU_MONITOR
	help
	  Cooperative priority for the CPU monitor thread.

config ASR_CPU_MONITOR_PERIOD_MS
	int "CPU monitor report interval in milliseconds"
	default 5000
	depends on ASR_CPU_MONITOR
	help
	  How often the CPU monitor samples and logs thread usage.
```

## tests/drivers/dynamixel_packet/testcase.yaml
```yaml
tests:
  drivers.dynamixel_packet:
    build_only: true
    integration_platforms:
      - qemu_cortex_m3
    platform_allow:
      - qemu_cortex_m3
    tags:
      - drivers
      - unit
```
